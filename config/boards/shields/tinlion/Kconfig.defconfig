## config/boards/shields/tinlion/Kconfig.defconfig
```kconfig
if SHIELD_TINLION_LEFT

config ZMK_KEYBOARD_NAME
    default "TinLion"

config ZMK_SPLIT_ROLE_CENTRAL
    default y

endif

if SHIELD_TINLION_LEFT || SHIELD_TINLION_RIGHT

config ZMK_SPLIT
    default y

endif
```

## config/boards/shields/tinlion/Kconfig.shield
```kconfig
config SHIELD_TINLION_LEFT
    def_bool $(shields_list_contains,tinlion_left)

config SHIELD_TINLION_RIGHT
    def_bool $(shields_list_contains,tinlion_right)
```
